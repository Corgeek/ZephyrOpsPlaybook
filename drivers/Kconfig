## drivers/Kconfig
```kconfig
# Copyright (c) 2024 Takayuki Goto <tkg.develop@gmail.com>
# SPDX-License-Identifier: Apache-2.0

menu "Onboard device drivers"

config BEEP
    bool "Enable Standard Beep function"
    depends on PWM

config BUTTON
    bool "Enable Standard Button function"
    depends on GPIO

config DISPLAY_WRAPPER
    bool "Enable Display wrapper driver of microbit"
    depends on MICROBIT_DISPLAY

###
# Accel drivers

config ACCEL_SENSOR
    bool "Enable Acceleration sensor driver"
    depends on I2C

if ACCEL_SENSOR
choice
    prompt "Choose magnetic sensor driver"

config ACCEL_LIS2DH
    bool "Enable LIS2DH driver"
    depends on I2C

endchoice
endif # ACCEL_SENSOR

###
# MAGNET drivers

config MAGNET_SENSOR
    bool "Enable Magnetic sensor driver"
    depends on I2C

if MAGNET_SENSOR
choice
    prompt "Choose magnetic sensor driver"

config MAGNET_LIS2MDL
    bool "Enable LIS2MDL driver"
    depends on I2C

endchoice
endif # MAGNET_SENSOR

###
# MEASURE drivers

config MEASURE_SENSOR
    bool "Enable Measure sensor driver"
    depends on I2C

if MEASURE_SENSOR
choice
    prompt "Choose measure sensor driver"

config TOF_VL53L4CD
    bool "Enable VL53L4CD driver"
    depends on I2C

endchoice
endif # MEASURE_SENSOR

endmenu
```

## drivers/sensor/Kconfig
```kconfig
# Copyright (c) 2024 Takayuki Goto <tkg.develop@gmail.com>
# SPDX-License-Identifier: Apache-2.0

menu "Sensor drivers"

config ACCEL_SENSOR
    bool "Enable LIS2DH driver"
    depends on LIS2DH

config MANGET_SENSOR
    bool "Enable LIS2MDL driver"
    depends on LIS2MDL

config MEASURE_SENSOR
    bool "Enable VL53L4CD driver"
    depends on I2C

endmenu
```
